/* Xiaomi Poco X4 Pro 5G (veux) - Touch Subsystem */

/* Fragment 64 -> &soc */
&soc {

	/* Xiaomi touchscreen input driver common interface */
	xiaomi_touch {
		compatible = "xiaomi-touch";
		status = "ok";
		touch,name = "xiaomi-touch";
	};
};

/* Fragment 65 -> &qupv3_se8_i2c */
&qupv3_se8_i2c {
	#address-cells = <0x01>;
	#size-cells = <0x00>;
	qcom,i2c-touch-active = "goodix,gt9896";
	status = "ok";

	/* Goodix GT9886 / GT9897 (GTX8) touchscreen controller at I2C 0x5d */
		goodix-gtx8@5d {
		compatible = "goodix,gt9896";
		goodix,avdd-gpio = <&tlmm>, <0x33 0x00>;
		goodix,dvdd-gpio = <&tlmm>, <0x2c 0x00>;
		goodix,irq-flags = <0x02>;
		goodix,irq-gpio = <&tlmm>, <0x16 0x2800>;
		goodix,panel-max-w = <0xff>;
		goodix,panel-max-x = <0x21c0>;
		goodix,panel-max-y = <0x4b00>;
		goodix,pen-enable;
		goodix,reset-gpio = <&tlmm>, <0x15 0x00>;
		interrupt-parent = <&tlmm>;
		interrupts = <0x16 0x2800>;
		panel = <&dsi_k6s_38_0c_0a_fhd_dsc_video>;
		pinctrl-0 = <&ts_active>;
		pinctrl-1 = <&ts_int_suspend>, <&ts_reset_suspend>;
		pinctrl-2 = <&pmx_ts_release>;
		pinctrl-names = "pmx_ts_active", "pmx_ts_suspend", "pmx_ts_release";
		reg = <0x5d>;
	};
};
